## Custom_Board_1/boards/arm/my_custom_board/Kconfig.board
```kconfig
# Copyright (c) 2022 Nordic Semiconductor ASA
# SPDX-License-Identifier: Apache-2.0

config BOARD_MY_CUSTOM_BOARD
	bool "My Custom Board"
	depends on SOC_NRF52833_QIAA
```

## Custom_Board_1/boards/arm/my_custom_board/Kconfig.defconfig
```kconfig
# Copyright (c) 2022 Nordic Semiconductor ASA
# SPDX-License-Identifier: Apache-2.0

if BOARD_MY_CUSTOM_BOARD

config BOARD
	default "my_custom_board"

config BT_CTLR
   default BT

endif
```

## example1/blinky/build_2/Kconfig/Kconfig.shield.defconfig
```kconfig
osource "c:/Users/sturkman/Desktop/nRF_Workspace/Custom_Board_1/boards/shields/*/Kconfig.defconfig"
osource "C:/ncs/v2.0.2/nrf/boards/shields/*/Kconfig.defconfig"
```
